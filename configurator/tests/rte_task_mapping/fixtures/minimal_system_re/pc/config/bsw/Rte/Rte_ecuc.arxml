AUTOSAR XML (schema 00046)
package /ActiveEcuC
  module config Rte: implementation-config-variant=VARIANT-PRE-COMPILE, module-description=Rte_Impl
    RteGeneration:
      RteDevErrorDetect = false
      RteVfbTraceEnabled = false
      RteVfbTraceFunction = 
      DataMappingGenerationOptimization1To1Rport = false
      DataMappingGenerationOptimizationNTo1Rport = false
      DataMappingGenerationOptimizationPport = false
      RteEaOptimization = false
      RteIsrSimplification = false
      RteSystemSignalCompuMethodEnabled = false
    RteBswGeneral
    4 x RteBswModuleInstance:
      CanSM: RteBswModuleConfigurationRef=CanSM
        CanSM_MainFunctionTimingEvent0 (RteBswEventToTaskMapping): RteBswActivationOffset=0.0, RteBswPositionInTask=3, RteBswEventRef=CanSM_MainFunctionTimingEvent0, RteBswMappedToTaskRef=OsTask_5ms
      Com: RteBswModuleConfigurationRef=Com
        3 x RteBswEventToTaskMapping, all with RteBswActivationOffset=0.0, RteBswMappedToTaskRef=OsTask_5ms:
          Com_MainFunction_RxTimingEvent0: RteBswPositionInTask=0, RteBswEventRef=Com_MainFunction_RxTimingEvent0
          Com_MainFunction_TxTimingEvent0: RteBswPositionInTask=1, RteBswEventRef=Com_MainFunction_TxTimingEvent0
          Com_MainFunction_GwTimingEvent0: RteBswPositionInTask=2, RteBswEventRef=Com_MainFunction_GwTimingEvent0
      PduR: RteBswImplementationRef=PduR_Impl
        3 x RteBswEventToTaskMapping, all with RteBswActivationOffset=0.0, RteBswMappedToTaskRef=OsTask_1ms:
          PduR_MainFunctionTimingEvent{0..2}: RteBswPositionInTask={0..2}, RteBswEventRef=PduR_MainFunctionTimingEvent{0..2}
      ComM: RteBswModuleConfigurationRef=ComM
        ComM_MainFunction_ComMChannel_0TimingEvent0 (RteBswEventToTaskMapping): RteBswActivationOffset=0.0, RteBswPositionInTask=4, RteBswEventRef=ComM_MainFunction_CAN1TimingEvent0, RteBswMappedToTaskRef=OsTask_5ms
    MinimalSystem_EcuSwComposition (RteSwComponentInstance): RteSoftwareComponentInstanceRef=SysCycle
      MinimalSystem_Init_Ev (RteEventToTaskMapping): RteActivationOffset=0.0, RtePositionInTask=0, RteEventRef=MinimalSystem_Init_Ev, RteMappedToTaskRef=OsTask_Init
      MinimalSystem_10ms_Ev (RteEventToTaskMapping): RteActivationOffset=0.0, RtePositionInTask=0, RteEventRef=MinimalSystem_10ms_Ev, RteMappedToTaskRef=OsTask_10ms
    IoHwAb_EcuSwComposition (RteSwComponentInstance): RteSoftwareComponentInstanceRef=ActCycle
      IoHwAb_10ms_Ev (RteEventToTaskMapping): RteActivationOffset=0.0, RtePositionInTask=1, RteEventRef=IoHwAb_10ms_Ev, RteMappedToTaskRef=OsTask_10ms
