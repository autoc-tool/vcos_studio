AUTOSAR XML (schema 00046)
package /ActiveEcuC
  module config Os: implementation-config-variant=VARIANT-PRE-COMPILE, module-description=Os_Impl
    OSDEFAULTAPPMODE (OsAppMode)
    OSAUTOSTARTMODE (OsAppMode)
    4 x OsApplication, all with OsIsPrivileged=true, OsAppMemoryProtectionIdentifier=, OsAppIsrRef=(unset):
      SystemApplication_Core0: OsAppCounterRef=OsCounter_0, OsAppEcucPartitionRef=EcucPartition_0, OsApplicationCoreRef=EcucCoreDefinition0, OsAppScheduleTableRef=SchTbl_5ms, OsAppTaskRef=core0_shell, OsAppScheduleTableRef=SchTbl_10ms, OsAppScheduleTableRef=SchTbl_1ms, OsAppTaskRef=OsTask_Init, OsAppTaskRef=OsTask_5ms, OsAppTaskRef=OsTask_10ms, OsAppTaskRef=OsTask_1ms
      SystemApplication_Core{1..3}: OsAppCounterRef=(unset), OsAppEcucPartitionRef=EcucPartition_{1..3}, OsApplicationCoreRef=EcucCoreDefinition{1..3}, OsAppScheduleTableRef=(unset), OsAppTaskRef=core{1..3}_shell
    4 x OsTask, all with OsTaskUsesFpu=true, OsTaskActivation=1, OsTaskStackSize=4096, OsTaskType=EXTENDED, OsTaskSchedule=FULL, OsTaskEventRef=(unset), OsTaskResourceRef=(unset):
      core0_shell: OsTaskPriority=10, OsTaskAccessingApplication=SystemApplication_Core0
        OsTaskAutostart: OsTaskAppModeRef=OSAUTOSTARTMODE
      core1_shell: OsTaskPriority=10, OsTaskAccessingApplication=SystemApplication_Core1
        OsTaskAutostart: OsTaskAppModeRef=OSAUTOSTARTMODE
      core2_shell: OsTaskPriority=5, OsTaskAccessingApplication=SystemApplication_Core2
        OsTaskAutostart: OsTaskAppModeRef=OSAUTOSTARTMODE
      core3_shell: OsTaskPriority=5, OsTaskAccessingApplication=SystemApplication_Core3
        OsTaskAutostart: OsTaskAppModeRef=OSAUTOSTARTMODE
    4 x OsCore:
      OsCore{0..3}: OsCoreBswApplicationRef=SystemApplication_Core{0..3}, OsCoreEcucIdRef=EcucCoreDefinition{0..3}
    4 x OsTask, all with OsTaskActivation=1, OsTaskStackSize=4096, OsTaskSchedule=FULL, OsTaskAccessingApplication=SystemApplication_Core0:
      OsTask_Init: OsTaskPriority=1, OsTaskUsesFpu=true, OsTaskType=EXTENDED
        OsTaskAutostart: OsTaskAppModeRef=OSAUTOSTARTMODE
      OsTask_5ms: OsTaskPriority=20, OsTaskUsesFpu=false, OsTaskType=BASIC
      OsTask_10ms: OsTaskPriority=25, OsTaskUsesFpu=false, OsTaskType=BASIC
      OsTask_1ms: OsTaskPriority=15, OsTaskUsesFpu=false, OsTaskType=BASIC
    OsCounter_0 (OsCounter):
      OsCounterMaxAllowedValue = 65535
      OsCounterMinCycle = 1
      OsCounterTicksPerBase = 1
      OsSecondsPerTick = 0.001
      OsCounterType = SOFTWARE
      OsCounterAccessingApplication = SystemApplication_Core0
    3 x OsScheduleTable, all with OsScheduleTableRepeating=true, OsScheduleTableCounterRef=OsCounter_0, OsSchTblAccessingApplication=SystemApplication_Core0:
      SchTbl_5ms: OsScheduleTableDuration=5
        OsScheduleTableExpiryPoint_0 (OsScheduleTableExpiryPoint): OsScheduleTblExpPointOffset=0
          OsScheduleTableTaskActivation_0 (OsScheduleTableTaskActivation): OsScheduleTableActivateTaskRef=OsTask_5ms
        OsScheduleTableAutostart: OsScheduleTableAutostartType=ABSOLUTE, OsScheduleTableStartValue=0, OsScheduleTableAppModeRef=OSAUTOSTARTMODE
      SchTbl_10ms: OsScheduleTableDuration=10
        OsScheduleTableExpiryPoint_0 (OsScheduleTableExpiryPoint): OsScheduleTblExpPointOffset=0
          OsScheduleTableTaskActivation_0 (OsScheduleTableTaskActivation): OsScheduleTableActivateTaskRef=OsTask_10ms
        OsScheduleTableAutostart: OsScheduleTableAutostartType=ABSOLUTE, OsScheduleTableStartValue=0, OsScheduleTableAppModeRef=OSAUTOSTARTMODE
      SchTbl_1ms: OsScheduleTableDuration=1
        OsScheduleTableExpiryPoint_0 (OsScheduleTableExpiryPoint): OsScheduleTblExpPointOffset=0
          OsScheduleTableTaskActivation_0 (OsScheduleTableTaskActivation): OsScheduleTableActivateTaskRef=OsTask_1ms
        OsScheduleTableAutostart: OsScheduleTableAutostartType=ABSOLUTE, OsScheduleTableStartValue=0, OsScheduleTableAppModeRef=OSAUTOSTARTMODE
    OsDerivativeInformation (OsPublishedInformation): OsKernelVersion=1.0.0, OsPlatformName=PC_Common
      OsDerivativeInformation
        4 x OsPhysicalCore:
          OsPhysicalCore_{0..3}: OsPhysicalCoreId={0..3}
