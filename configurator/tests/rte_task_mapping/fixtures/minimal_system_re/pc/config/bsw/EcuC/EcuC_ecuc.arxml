AUTOSAR XML (schema 00046)
package /ActiveEcuC
  module config EcuC: implementation-config-variant=VARIANT-PRE-COMPILE, module-description=Com_Impl
    EcucConfigSet
      EcucPduCollection: PduIdTypeEnum=UINT16, PduLengthTypeEnum=UINT16
        MetaDataType
          MetaDataItem: MetaDataItemLength=1, MetaDataItemType=CAN_ID_32
        3 x Pdu, all with EcucPduDefaultCoreRef=EcucCoreDefinition0:
          Cmd_Control: PduLength=8
          ECU_Status: PduLength=8
          Fault_Event: PduLength=2
    EcucHardware
      4 x EcucCoreDefinition:
        EcucCoreDefinition{0..3}: EcucCoreId={0..3}, EcucCoreHwRef=OsPhysicalCore_{0..3}
    EcucPartitionCollection
      4 x EcucPartition, all with EcucPartitionQmBswModuleExecution=false, PartitionCanBeRestarted=false, ASIL=QM:
        EcucPartition_0: EcucPartitionBswModuleExecution=true, EcucPartitionSoftwareComponentInstanceRef=COMPOSITIONTYPE.SysCycle, EcucPartitionBswModuleDistinguishedPartition=, EcucPartitionSoftwareComponentInstanceRef=COMPOSITIONTYPE.ActCycle
        EcucPartition_{1..3}: EcucPartitionBswModuleExecution=false, EcucPartitionSoftwareComponentInstanceRef=(unset), EcucPartitionBswModuleDistinguishedPartition=(unset)
