AUTOSAR XML (schema 00046)
package /ActiveEcuC
  module config ComM: implementation-config-variant=VARIANT-PRE-COMPILE, module-description=ComM_Impl
    ComMGeneral:
      ComM0PncVectorAvoidance = false
      ComMDevErrorDetect = false
      ComMDirectUserMapping = false
      ComMModeLimitationEnabled = false
      ComMPncGatewayEnabled = false
      ComMPncSupport = false
      ComMResetAfterForcingNoComm = false
      ComMSynchronousWakeUp = true
      ComMVersionInfoApi = false
      ComMWakeupInhibitionEnabled = false
      ComMPncPrepareSleepTimer = 0
      ComMTMinFullComModeDuration = 5
      ComMEcuGroupClassification = 3
      ComMGlobalNvMBlockDescriptor = <empty>
    ComMConfigSet: ComMPncEnabled=false
      ComMChannel_0 (ComMChannel):
        ComMBusType = COMM_BUS_TYPE_CAN
        ComMChannelId = 0
        ComMFullCommRequestNotificationEnabled = false
        ComMMainFunctionPeriod = 0.01
        ComMNoCom = false
        ComMNoWakeup = false
        ComMNoWakeUpInhibitionNvmStorage = (unset)
        ComMNetworkManagement: ComMNmVariant=NONE, ComMPncNmRequest=false
        ComMUserPerChannel_0 (ComMUserPerChannel): ComMUserChannel=ComMUser_0
      ComMUser_0 (ComMUser): ComMUserIdentifier=0
