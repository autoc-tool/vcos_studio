AUTOSAR XML (schema 00046)
package /AUTOSAR/ComM_ib_bswmd/BswModuleDescriptions
  bsw module description ComM
    provided-entrys:
      ComM_MainFunction_All_Channels
      ComM_MainFunction_CAN{1..4}
      ComM_MainFunction_LIN1
      ComM_MainFunction_LIN2
    bsw internal behavior ComMBehavior
      8 x exclusive area:
        COMM_EXCLUSIVE_AREA_0
        COMM_EXCLUSIVE_AREA_1
        COMM_EXCLUSIVE_AREA_{2..7}  # This exclusive area is only used in case of multi-partition. It must be configured as a spinlock to allow access to some variables simultaneously from multiple cores.
      7 x bsw schedulable entity:
        ComM_MainFunction_All_Channels: implemented-entry=ComM_MainFunction_All_Channels
        ComM_MainFunction_CAN{1..4}: implemented-entry=ComM_MainFunction_CAN{1..4}
        ComM_MainFunction_LIN1: implemented-entry=ComM_MainFunction_LIN1
        ComM_MainFunction_LIN2: implemented-entry=ComM_MainFunction_LIN2
      6 x bsw timing event, all with period=0.005:
        ComM_MainFunction_CAN{1..4}TimingEvent0: starts-on-event=ComM_MainFunction_CAN{1..4}
        ComM_MainFunction_LIN1TimingEvent0: starts-on-event=ComM_MainFunction_LIN1
        ComM_MainFunction_LIN2TimingEvent0: starts-on-event=ComM_MainFunction_LIN2
  7 x bsw module entry, all with call-type=SCHEDULED, execution-context=TASK:
    ComM_MainFunction_All_Channels
    ComM_MainFunction_CAN{1..4}
    ComM_MainFunction_LIN1
    ComM_MainFunction_LIN2
