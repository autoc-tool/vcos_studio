AUTOSAR XML (schema 00046)
package /AUTOSAR/Com_ib_bswmd/BswModuleDescriptions
  bsw module description Com: provided-entrys=[Com_MainFunction_Rx, Com_MainFunction_Tx, Com_MainFunction_Gw]
    bsw internal behavior ComBehavior
      exclusive area COM_EXCLUSIVE_AREA_0  # This critical section protects Tx ressources that can be accessed from various contexts. Therefore the critical section enclosed with COM_EXCLUSIVE_AREA_TX should never be interrupted by any Com API which accesses Tx ressources. For more details, see DocTechRef.
      exclusive area COM_EXCLUSIVE_AREA_1  # This critical section protects Tx ressources that can be accessed from various contexts. Therefore the critical section enclosed with COM_EXCLUSIVE_AREA_TX should never be interrupted by any Com API which accesses Tx ressources. For more details, see DocTechRef.
      bsw schedulable entity Com_MainFunction_Rx: implemented-entry=Com_MainFunction_Rx
      bsw schedulable entity Com_MainFunction_Tx: implemented-entry=Com_MainFunction_Tx
      bsw schedulable entity Com_MainFunction_Gw: implemented-entry=Com_MainFunction_Gw
      bsw timing event Com_MainFunction_RxTimingEvent0: starts-on-event=Com_MainFunction_Rx, period=0.005
      bsw timing event Com_MainFunction_TxTimingEvent0: starts-on-event=Com_MainFunction_Tx, period=0.005
      bsw timing event Com_MainFunction_GwTimingEvent0: starts-on-event=Com_MainFunction_Gw, period=0.005
  bsw module entry Com_MainFunction_Rx: call-type=SCHEDULED, execution-context=TASK
  bsw module entry Com_MainFunction_Tx: call-type=SCHEDULED, execution-context=TASK
  bsw module entry Com_MainFunction_Gw: call-type=SCHEDULED, execution-context=TASK
