AUTOSAR XML (schema 4-2-1)
package /COM/VCOS2/CFG/WORKFLOW/SYSDESC/SYNC
  composition sw component type COMPOSITIONTYPE  # UB:Derived from original system description
    component SysCycle: type=MinimalSystem
    component ActCycle: type=IoHwAb
    connect SysCycle.IoOut -> ActCycle.IoIn
  end to end protection set E2EPROTECTIONSET
  port interface mapping set PORTINTERFACEMAPPINGSET
  system SYSTEM: category=ECU_EXTRACT
    system mapping MAPPINGS
      data-mappings:
        data-element=SysCycle.COMPOSITIONTYPE.CmdControl.LedCmd, system-signal=LedCmd
        data-element=SysCycle.COMPOSITIONTYPE.CmdControl.TargetMode, system-signal=TargetMode
        data-element=SysCycle.COMPOSITIONTYPE.CmdControl.Cmd_AliveCnt, system-signal=Cmd_AliveCnt
        data-element=SysCycle.COMPOSITIONTYPE.CmdControl.PwmDuty, system-signal=PwmDuty
        data-element=SysCycle.COMPOSITIONTYPE.CmdControl.Cmd_Crc8, system-signal=Cmd_Crc8
        data-element=SysCycle.COMPOSITIONTYPE.EcuStatus.ECU_State, system-signal=ECU_State
        data-element=SysCycle.COMPOSITIONTYPE.EcuStatus.ECU_AliveCnt, system-signal=ECU_AliveCnt
        data-element=SysCycle.COMPOSITIONTYPE.EcuStatus.Temperature, system-signal=Temperature
        data-element=SysCycle.COMPOSITIONTYPE.EcuStatus.SupplyVoltage, system-signal=SupplyVoltage
        data-element=SysCycle.COMPOSITIONTYPE.EcuStatus.FaultFlags, system-signal=FaultFlags
        data-element=SysCycle.COMPOSITIONTYPE.FaultEvent.FaultCode, system-signal=FaultCode
        data-element=SysCycle.COMPOSITIONTYPE.FaultEvent.FaultActive, system-signal=FaultActive
      sw-mappings:
        swc to ecu mapping SwcToEcuMapping: component=[COMPOSITIONTYPE.SysCycle, COMPOSITIONTYPE.ActCycle], ecu-instance=DUT
    root-software-compositions:
      root sw composition prototype COMPOSITIONTYPE: flat-map=FLATMAP, software-composition=COMPOSITIONTYPE
